## CMakeLists.txt
```
#
# Copyright (c) 2021 Nordic Semiconductor
#
# SPDX-License-Identifier: LicenseRef-Nordic-5-Clause
#

cmake_minimum_required(VERSION 3.20.0)

find_package(Zephyr REQUIRED HINTS $ENV{ZEPHYR_BASE})
project(sms_2)

# NORDIC SDK APP START
target_sources(app PRIVATE src/main.c)
# NORDIC SDK APP END
```

## prj.conf
```kconfig
#
# Copyright (c) 2021 Nordic Semiconductor ASA
#
# SPDX-License-Identifier: LicenseRef-Nordic-5-Clause
#
# General config

CONFIG_SMS_SEND_PHONE_NUMBER="+358451115666"

CONFIG_SMS=y
CONFIG_SMS_SUBSCRIBERS_MAX_CNT=2
CONFIG_SMS_LOG_LEVEL_DBG=n
CONFIG_MAIN_STACK_SIZE=4096

# Networking
CONFIG_NETWORKING=y
CONFIG_NET_SOCKETS=y
CONFIG_NET_SOCKETS_OFFLOAD=y
CONFIG_NRF_MODEM_LIB=y
CONFIG_POSIX_API=y

# LTE link control
CONFIG_LTE_LINK_CONTROL=y
CONFIG_MODEM_INFO=y
CONFIG_NET_STATISTICS=y


# AT commands
CONFIG_AT_HOST_LIBRARY=y
CONFIG_AT_CMD_CUSTOM=y
CONFIG_DEBUG_THREAD_INFO=y
CONFIG_AT_SHELL=y

# Maybe useful RTT commands
CONFIG_SEGGER_RTT_BUFFER_SIZE_DOWN=32
CONFIG_SHELL_BACKENDS=y
#CONFIG_SHELL_RTT_INIT_LOG_LEVEL_WRN=y
#CONFIG_SHELL_RTT_LOG_LEVEL_DBG=y
#CONFIG_SHELL_BACKEND_RTT=y
#CONFIG_SHELL=y
#CONFIG_LOG_BACKEND_RTT_MODE_DROP=y

# Enable UART for communication
CONFIG_UART_INTERRUPT_DRIVEN=y


CONFIG_STDOUT_CONSOLE=y
# enable to use thread names
CONFIG_THREAD_NAME=y
CONFIG_THREAD_MONITOR=y
CONFIG_SEGGER_SYSTEMVIEW=y
CONFIG_USE_SEGGER_RTT=y
CONFIG_TRACING=y
# enable for post-mortem tracing
CONFIG_SEGGER_SYSVIEW_POST_MORTEM_MODE=n


# Debugging
CONFIG_LOG=y
CONFIG_ASSERT=y
CONFIG_ASSERT_VERBOSE=y
CONFIG_LOG_DEFAULT_LEVEL=3
CONFIG_USE_SEGGER_RTT=y
CONFIG_RTT_CONSOLE=y
CONFIG_UART_CONSOLE=n
CONFIG_LOG_BACKEND_RTT=y
CONFIG_LOG_BACKEND_UART=n
```

## src/main.c
```c
#include <stdio.h>
#include <zephyr/kernel.h>
#include <zephyr/logging/log.h>
#include <modem/sms.h>
#include <modem/lte_lc.h>
#include "connect_example.h"
#include <modem/modem_info.h>
#include <modem/nrf_modem_lib.h>
#include <stdbool.h>
#include <string.h>
#include <nrf_modem_at.h> 
#include <zephyr/sys/printk.h>




LOG_MODULE_REGISTER(at_rtt_modem, LOG_LEVEL_INF);


/* Initialize modem */
static void modem_init(void) {
    int32_t retval = 0;

    struct modem_param_info modem_info;


	
	
	
  	modem_info_init();
    

    /* Get modem information */
    modem_info_params_init(&modem_info);
    LOG_INF("Initializing LTE modem...");


    retval = nrf_modem_lib_init();
	if(retval != 0){
		LOG_ERR("Failed to initialize nrf modem lib (%d)",retval);
		k_msleep(5000);
		
	}

    LOG_INF("Modem initialized");
}


int main(void) {
    char resp[256];
    int32_t retval;

    LOG_INF("AT Command over RTT Interface Example");


    modem_init();


      //  TRACE_START();
      SEGGER_SYSVIEW_Start();
    /* Send some example AT commands */
    
    retval = nrf_modem_at_scanf("AT+CFUN?","%s",resp);
    if(retval == 1){
        LOG_INF("Query modem functionality: %s",resp);
    }

    retval = nrf_modem_at_scanf("AT+CGMI","%s",resp);
    if(retval == 1){
        LOG_INF(" Manufacturer identification: %s",resp);
    }

    retval = nrf_modem_at_scanf("AT+CGSN","%s",resp);
    if(retval == 1){
        LOG_INF("Request product serial number: %s",resp);
    }

    retval = nrf_modem_at_scanf("AT+CIMI","%s",resp);
    if(retval == 1){
        LOG_INF("Request IMSI: %s",resp);
    }

    retval = nrf_modem_at_scanf("AT+CREG?","%s",resp);
    if(retval == 1){
        LOG_INF("Network Registration Status: %s",resp);
    }
         // TRACE_STOP();
         SEGGER_SYSVIEW_Stop();
    //Register to cereg notifications
    retval = nrf_modem_at_printf("AT+CEREG=%d",CEREG_NOTIFICATION_LEVEL);
	if (retval) {
		LOG_INF("AT+CEREG failed");
		return -1;
	}


    return 0;
    
}
```
